## Kconfig.projbuild
```kconfig
#
# For a description of the syntax of this configuration file,
# see the file kconfig-language.txt in the NuttX tools repository.
#
menu "PTP Daemon Configuration"

    config NETUTILS_PTPD
        bool "PTPD client/server"
        default y
    #depends on NET_IPv4
    #depends on NET_IGMP
    #depends on NET_UDP
        help
            Build a minimal implementation of IEEE-1588 precision time protocol.
            Uses system gettimeofday() and adjtime() calls to synchronize clock
            with a timetransmitter clock through network, or to provide a
            timetransmitter clock to other systems.

    if NETUTILS_PTPD

        config NETUTILS_PTPD_DEBUG
            bool "Enable PTP debug messages"
            default n
            depends on DEBUG_INFO
            help
                Enable PTP debug messages even if CONFIG_DEBUG_NET_INFO is not enabled.

         config NETUTILS_PTPD_GPTP_PROFILE
            bool "Enable gPTP profile"
            default y
            help
                Act as a gPTP endpoint, capable of supporting Audio/Video Bridging (AVB).

        config NETUTILS_PTPD_CLIENT
            bool "Enable client support"
            default y
            help
                Act as a PTP client, synchronizing the NuttX clock to a remote master
                clock.

        config NETUTILS_PTPD_SERVER
            bool "Enable server support"
            default n
            help
                Act as a PTP server, providing NuttX clock time to other systems.

                Both server and client can be simultaneously enabled. NuttX will then
                synchronize to a higher priority timetransmitter clock, or act as a
                timetransmitter clock itself if it has the highest priority.
                Refer to the BTCA in IEEE-1588 for details.

        config NETUTILS_PTPD_STACKSIZE
            int "PTP daemon stack stack size"
            default 4096 # DEFAULT_TASK_STACKSIZE

        config NETUTILS_PTPD_SERVERPRIO
            int "PTP daemon priority"
            default 100

        config NETUTILS_PTPD_DOMAIN
            int    "PTP domain selection"
            default 0
            range 0 127
            help
                Set PTP domain to participate in. Default domain is 0, other domains
                can be used to isolate reference clocks from each other.

        if NETUTILS_PTPD_SERVER || NETUTILS_PTPD_GPTP_PROFILE

            config NETUTILS_PTPD_PRIORITY1
                int "PTP server priority1"
                default 128
                range 0 255
                help
                    Set clock priority to announce when acting as a PTP server.
                    Lower value is higher priority.
                    A higher priority1 clock will be selected without regard to announced
                    clock quality fields.
                    Refer to Best Master Clock algorithm in IEEE-1588 for details.

            config NETUTILS_PTPD_PRIORITY2
                int "PTP server priority2"
                default 128
                range 0 255
                help
                    Set clock subpriority to announce when acting as a PTP server.
                    This will distinguish between two clocks that are equivalent in
                    priority1, class and accuracy values.
                    Lower value is higher priority.

            config NETUTILS_PTPD_CLASS
                int "PTP server class"
                default 248
                range 0 255
                help
                    Set BTC clock class to announce when acting as a PTP server.
                    Lower value means higher quality clock source.
                    248 is the default for unknown class.

            config NETUTILS_PTPD_ACCURACY
                int "PTP server accuracy"
                default 254
                range 0 255
                help
                    Set BTC clock accuracy to announce when acting as a PTP server.
                    Logarithmic scale is defined in IEEE-1588:
                    32: +-  25 ns
                    33: +- 100 ns
                    34: +- 250 ns
                    35: +-   1 us
                    36: +-   2.5 us
                    37: +-  10 us
                    38: +-  25 us
                    39: +- 100 us
                    40: +- 250 us
                    41: +-   1 ms
                    42: +-   2.5 ms
                    43: +-  10 ms
                    44: +-  25 ms
                    45: +- 100 ms
                    46: +- 250 ms
                    47: +-   1 s
                    48: +-  10 s
                    49: +-  more than 10 s
                    254: Unknown

            config NETUTILS_PTPD_CLOCKSOURCE
                int "PTP server clock source type"
                default 160
                range 0 255
                help
                    Set clock source type to announce when acting as a PTP server.
                    Common values:
                    32: GPS
                    64: PTP
                    80: NTP
                    144: Other
                    160: Internal oscillator

            config NETUTILS_PTPD_SYNC_INTERVAL_MS
                int "PTP server sync transmit interval (ms)"
                default 1000
                help
                    How often to transmit sync packets in server mode.

            config NETUTILS_PTPD_ANNOUNCE_INTERVAL_MS
                int "PTP server announce transmit interval (ms)"
                default 10000
                help
                    How often to transmit announce packets in server mode.

            config NETUTILS_PTPD_TWOSTEP_SYNC
                bool "PTP server sends two-step synchronization packets"
                default y
                help
                    If enabled, sends a follow-up packet after every sync packet.
                    This helps compensate for the time taken to initiate the transmission.
                    If gPTP profile is enabled, this setting is ignored (acts as y).

            config NETUTILS_PTPD_DELAYREQ_INTERVAL_MS
                int "PTP server suggested interval of delay requests"
                default 16000
                help
                    When responding to a delay request, the server can inform the client
                    how often it should test path delay. Default value is 16000 ms.
                    If gPTP profle is enabled, this setting is ignored (interval = 1000 ms).

        endif # NETUTILS_PTPD_SERVER

        if NETUTILS_PTPD_CLIENT || NETUTILS_PTPD_GPTP_PROFILE

            config NETUTILS_PTPD_TIMEOUT_MS
                int "PTP client timeout for changing clock source (ms)"
                default 60000
                help
                    If no packets are being received from currently chosen clock source,
                    fall back to next best clock source after this many seconds.

            config NETUTILS_PTPD_SETTIME_THRESHOLD_MS
                int "PTP client threshold for changing system time (ms)"
                default 1000
                help
                    If difference between local and remote clock exceeds this threshold,
                    time is reset with settimeofday() instead of changing the rate with
                    adjtime().

            config NETUTILS_PTPD_DRIFT_AVERAGE_S
                int "PTP client clock drift rate averaging time (s)"
                default 600
                range 10 86400
                help
                    Clock drift rate is averaged over this time period. Larger value
                    gives more stable estimate but reacts slower to crystal oscillator speed
                    changes (such as caused by temperature changes).

        # Commented options not used by ESP_PTP
        #config NETUTILS_PTPD_MULTICAST_TIMEOUT_MS
        #    int "PTP client timeout to rejoin multicast group (ms)"
        #    default 30000 #esp32
        #    default 0
        #    help
        #        If no PTP multicast packets are being received, attempt to rejoin the
        #        multicast group. This can be necessary if network topology changes, or
        #        depending on hardware, after some error recovery events.
        #        Set to 0 to disable.

            config NETUTILS_PTPD_SEND_DELAYREQ
                bool "PTP client enable delay requests"
                default n
                help
                    If enabled, sends delay request messages to measure the network delay
                    to server. If disabled, assumes no delay. If gPTP profile is enabled,
                    this setting is ignored (acts as y).

            if NETUTILS_PTPD_SEND_DELAYREQ || NETUTILS_PTPD_GPTP_PROFILE

                config NETUTILS_PTPD_MAX_PATH_DELAY_NS
                    int "PTP client maximum path delay (ns)"
                    default 100000
                    range 1 1000000000
                    help
                        Measured path delay longer than this is ignored. Delay requests are
                        also not transmitted until clock synchronization is better than this.

                config NETUTILS_PTPD_DELAYREQ_AVGCOUNT
                    int "PTP client path/peer delay averaging count"
                    default 100
                    help
                        Measured path/peer delay is averaged over this many samples.

                config NETUTILS_PTPD_PATH_DELAY_STABILITY_NS
                    int "PTP client send delay request when clock stability (ns)"
                    default 250
                    help
                        Sends path delay request only once the internal clock is stable and skews only
                        in defined interval.
                config NETUTILS_PTPD_PEER_DELAY_STABILITY_NS
                    int "PTP client send peer delay request when clock stability (ns)"
                    default 100
                    help
                        Sends peer delay request only once the internal clock is stable and skews only
                        in defined interval.

            endif # NETUTILS_PTPD_SEND_DELAYREQ

        endif # NETUTILS_PTPD_CLIENT

        config ESP_PTP_NUM_PORTS
            int "Number of PTP ports"
            default 1
            range 1 2
            depends on NETUTILS_PTPD
            help
                Number of independent PTP port instances managed by the
                daemon. The default is 1 (a single endpoint port). Set to
                2 for time-aware bridges (two BRIDGED ports) or endpoints
                with failover (one PRIMARY + one FAILOVER port).

        # Per-port configuration. Each port has five independent knobs:
        #
        #   MEDIUM     ethernet | wifi
        #              The link-layer technology on the wire.
        #
        #   HOST_IF    emac | ahb | sdio | spi | usb | other
        #              How the port is attached to the host SoC. Determines
        #              the achievable PTP timestamp accuracy and the per-port
        #              admission budget — emac is the only one with
        #              hardware timestamping and lowest latency; ahb is the
        #              native on-chip Wi-Fi MAC; sdio is the typical
        #              P4+C6 coprocessor link; spi covers external Eth/Wi-Fi
        #              chips and is the slowest of the four.
        #
        #   TYPE       primary | failover | bridged
        #              primary  : main port for an endpoint (required if
        #                         NUM_PORTS == 1)
        #              failover : hot-standby for the primary
        #              bridged  : participates in an L2 bridge with the
        #                         other bridged port(s)
        #
        #   WIFI_MODE  ap | sta
        #              only meaningful for medium=wifi. ap transmits
        #              beacons (FollowUpInfo carrier) and responds to FTM;
        #              sta consumes beacons and initiates FTM.
        #
        #   LINK_SPEED_MBPS
        #              Nominal PHY-rate cap, in megabits per second. Used
        #              for MSRP admission math and for failover scoring.
        #              Typical: 100 / 1000 (eth), 150 / 300 / 600 (Wi-Fi
        #              negotiated cap).

        choice ESP_PTP_PORT0_MEDIUM
            prompt "Port 0 medium"
            default ESP_PTP_PORT0_MEDIUM_ETHERNET
            depends on NETUTILS_PTPD

            config ESP_PTP_PORT0_MEDIUM_ETHERNET
                bool "ethernet"
            config ESP_PTP_PORT0_MEDIUM_WIFI
                bool "wifi"
        endchoice

        choice ESP_PTP_PORT0_HOST_IF
            prompt "Port 0 host interface"
            default ESP_PTP_PORT0_HOST_IF_EMAC if ESP_PTP_PORT0_MEDIUM_ETHERNET
            default ESP_PTP_PORT0_HOST_IF_AHB  if ESP_PTP_PORT0_MEDIUM_WIFI
            depends on NETUTILS_PTPD

            config ESP_PTP_PORT0_HOST_IF_EMAC
                bool "emac"
            config ESP_PTP_PORT0_HOST_IF_AHB
                bool "ahb"
            config ESP_PTP_PORT0_HOST_IF_SDIO
                bool "sdio"
            config ESP_PTP_PORT0_HOST_IF_SPI
                bool "spi"
            config ESP_PTP_PORT0_HOST_IF_USB
                bool "usb"
            config ESP_PTP_PORT0_HOST_IF_OTHER
                bool "other"
        endchoice

        choice ESP_PTP_PORT0_TYPE
            prompt "Port 0 type"
            default ESP_PTP_PORT0_TYPE_PRIMARY
            depends on NETUTILS_PTPD

            config ESP_PTP_PORT0_TYPE_PRIMARY
                bool "primary"
            config ESP_PTP_PORT0_TYPE_FAILOVER
                bool "failover"
                depends on ESP_PTP_NUM_PORTS = 2
            config ESP_PTP_PORT0_TYPE_BRIDGED
                bool "bridged"
                depends on ESP_PTP_NUM_PORTS = 2
        endchoice

        choice ESP_PTP_PORT0_WIFI_MODE
            prompt "Port 0 wifi mode"
            default ESP_PTP_PORT0_WIFI_MODE_STA
            depends on NETUTILS_PTPD
            depends on ESP_PTP_PORT0_MEDIUM_WIFI

            config ESP_PTP_PORT0_WIFI_MODE_AP
                bool "ap"
            config ESP_PTP_PORT0_WIFI_MODE_STA
                bool "sta"
        endchoice

        config ESP_PTP_PORT0_LINK_SPEED_MBPS
            int "Port 0 nominal link speed (Mbps)"
            default 1000 if ESP_PTP_PORT0_MEDIUM_ETHERNET
            default 150  if ESP_PTP_PORT0_MEDIUM_WIFI
            depends on NETUTILS_PTPD

        choice ESP_PTP_PORT1_MEDIUM
            prompt "Port 1 medium"
            default ESP_PTP_PORT1_MEDIUM_WIFI
            depends on NETUTILS_PTPD && ESP_PTP_NUM_PORTS = 2

            config ESP_PTP_PORT1_MEDIUM_ETHERNET
                bool "ethernet"
            config ESP_PTP_PORT1_MEDIUM_WIFI
                bool "wifi"
        endchoice

        choice ESP_PTP_PORT1_HOST_IF
            prompt "Port 1 host interface"
            default ESP_PTP_PORT1_HOST_IF_SDIO if ESP_PTP_PORT1_MEDIUM_WIFI
            default ESP_PTP_PORT1_HOST_IF_EMAC if ESP_PTP_PORT1_MEDIUM_ETHERNET
            depends on NETUTILS_PTPD && ESP_PTP_NUM_PORTS = 2

            config ESP_PTP_PORT1_HOST_IF_EMAC
                bool "emac"
            config ESP_PTP_PORT1_HOST_IF_AHB
                bool "ahb"
            config ESP_PTP_PORT1_HOST_IF_SDIO
                bool "sdio"
            config ESP_PTP_PORT1_HOST_IF_SPI
                bool "spi"
            config ESP_PTP_PORT1_HOST_IF_USB
                bool "usb"
            config ESP_PTP_PORT1_HOST_IF_OTHER
                bool "other"
        endchoice

        choice ESP_PTP_PORT1_TYPE
            prompt "Port 1 type"
            default ESP_PTP_PORT1_TYPE_BRIDGED
            depends on NETUTILS_PTPD && ESP_PTP_NUM_PORTS = 2

            config ESP_PTP_PORT1_TYPE_PRIMARY
                bool "primary"
            config ESP_PTP_PORT1_TYPE_FAILOVER
                bool "failover"
            config ESP_PTP_PORT1_TYPE_BRIDGED
                bool "bridged"
        endchoice

        choice ESP_PTP_PORT1_WIFI_MODE
            prompt "Port 1 wifi mode"
            default ESP_PTP_PORT1_WIFI_MODE_AP
            depends on NETUTILS_PTPD && ESP_PTP_NUM_PORTS = 2
            depends on ESP_PTP_PORT1_MEDIUM_WIFI

            config ESP_PTP_PORT1_WIFI_MODE_AP
                bool "ap"
            config ESP_PTP_PORT1_WIFI_MODE_STA
                bool "sta"
        endchoice

        config ESP_PTP_PORT1_LINK_SPEED_MBPS
            int "Port 1 nominal link speed (Mbps)"
            default 150  if ESP_PTP_PORT1_MEDIUM_WIFI
            default 1000 if ESP_PTP_PORT1_MEDIUM_ETHERNET
            depends on NETUTILS_PTPD && ESP_PTP_NUM_PORTS = 2

        # Derived: at least one port is Wi-Fi-AP reached via a coprocessor
        # (sdio or spi). Gates the beacon-IE publish code path in
        # ptp_beacon_ie.c (we publish through ESP-Hosted's beacon-Vendor-IE
        # API rather than the native esp_wifi one).
        config ESP_PTP_HAS_AP_VIA_COPROCESSOR
            bool
            default y if (ESP_PTP_PORT0_MEDIUM_WIFI && ESP_PTP_PORT0_WIFI_MODE_AP && (ESP_PTP_PORT0_HOST_IF_SDIO || ESP_PTP_PORT0_HOST_IF_SPI))
            default y if (ESP_PTP_PORT1_MEDIUM_WIFI && ESP_PTP_PORT1_WIFI_MODE_AP && (ESP_PTP_PORT1_HOST_IF_SDIO || ESP_PTP_PORT1_HOST_IF_SPI))
            default n

    endif # NETUTILS_PTPD

endmenu # PTP Daemon Configuration
```
